#define VERSION_MACRO
macro_ver: macro_ver {
compatible = "zmk,behavior-macro";
label = "macro_ver";
#binding-cells = <0>;
bindings = <&kp N2>, <&kp N0>, <&kp N2>, <&kp N3>, <&kp N1>, <&kp N2>, <&kp N1>, <&kp N7>, <&kp MINUS>, <&kp J>, <&kp I>, <&kp M>, <&kp MINUS>, <&kp F>, <&kp B>, <&kp E>, <&kp N2>, <&kp N1>, <&kp D>, <&kp A>, <&kp RET>;
};
